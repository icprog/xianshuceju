/*********************************Copyright (c)*********************************                                      
  *                                                 
  ******************************************************************************
  * 文件名称：LED.C
  * 描    述：LED模块
  * 创 建 者: 
  * 创建日期: 
  * 修 改 者:             
  * 修改日期: 
  * 版    本: v1.0.0
  ******************************************************************************
  * attention
  *
  ******************************************************************************
  */
/*Includes --------------------------------------------------------------------*/
  #include "includes.h"
  #include "LED.H" 

/********************************************************************************
函数名称：LED_Init()
功    能：板载LED初始化
参    数：无
返 回 值：无
*********************************************************************************/
void LED_Init(void)
{
     GPIO_InitTypeDef        GPIO_InitStructure;
     
     /* GPIOE 外部时钟使能 */
     RCC_AHBPeriphClockCmd(LED_PORT_CLK, ENABLE);
	
     /* 配置 LED灯端口 外部输出上拉模式 */
     GPIO_InitStructure.GPIO_Pin   = LED_PIN;
     GPIO_InitStructure.GPIO_Mode =  GPIO_Mode_OUT;
     GPIO_InitStructure.GPIO_OType = GPIO_OType_PP;
     GPIO_InitStructure.GPIO_PuPd =  GPIO_PuPd_UP;
     GPIO_InitStructure.GPIO_Speed = GPIO_Speed_50MHz;
     GPIO_Init(LED_PORT , &GPIO_InitStructure);
     //关闭LED
     GPIO_ResetBits(LED_PORT ,LED_PIN_1);
	  

}
/********************************************************************************
函数名称：LED_BLINK()
功    能：单个灯闪亮
参    数：无
返 回 值：无
*********************************************************************************/
void LED_BLINK(void)
{
    GPIO_WriteBit(LED_PORT, LED_PIN_1  , 
		             (BitAction)((1-GPIO_ReadOutputDataBit(LED_PORT, LED_PIN_1))));
	  Delay_Ms(50);
}
/********************************************************************************
函数名称：Delay()
功    能：延时函数
参    数：无
返 回 值：无
*********************************************************************************/
void Delay(__IO uint32_t nCount)
{
  /* Decrement nCount value */
  while (nCount != 0)
  {
		nCount--;
  }
}
/********************************************************************************
函数名称：Delay_Us()
功    能：软件延时微秒级函数
参    数：无
返 回 值：无
*********************************************************************************/
void Delay_Us(__IO uint32_t nCount)
{
  /* 10uS延迟=>10.8uS,100uS延迟=>104uS*/
  while (nCount != 0)
  {
	   nCount--;  
	   Delay(150);
  }
}
/********************************************************************************
函数名称：Delay_Ms()
功    能：软件延时豪秒级函数
参    数：无
返 回 值：无
*********************************************************************************/
void Delay_Ms(__IO uint32_t nCount)
{
  /* 10uS延迟=>10.8uS,100uS延迟=>104uS*/
  while (nCount != 0)
  {
	nCount--;  
	Delay(15000);
  }
}
 
